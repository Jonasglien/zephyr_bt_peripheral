## CMakeLists.txt
```
# SPDX-License-Identifier: Apache-2.0

cmake_minimum_required(VERSION 3.13.1)


find_package(Zephyr REQUIRED HINTS $ENV{ZEPHYR_BASE})
project(proj)
zephyr_compile_definitions(PROJECT_NAME=${PROJECT_NAME})
zephyr_compile_definitions(_POSIX_C_SOURCE=200809L)

# HEADER FILES
zephyr_library_include_directories( 
     src/bluetooth/
     src/bluetooth/services
     )

# APPLICATION SOURCE FILES
add_subdirectory(src/bluetooth)

target_sources(app PRIVATE ${CMAKE_CURRENT_SOURCE_DIR}/src/main.c)
```

## prj.conf
```kconfig
CONFIG_GPIO=y

CONFIG_NO_OPTIMIZATIONS=y

# I2C
CONFIG_I2C=y


CONFIG_INIT_STACKS=y
CONFIG_THREAD_STACK_INFO=y
CONFIG_MAIN_STACK_SIZE=2048
CONFIG_SYSTEM_WORKQUEUE_STACK_SIZE=4096
CONFIG_BT_RX_STACK_SIZE=4096

CONFIG_BT=y
CONFIG_BT_DEBUG_LOG=y
CONFIG_BT_DEBUG_SMP=y
CONFIG_BT_SMP=y
#CONFIG_BT_SMP_SC_ONLY=y  
#CONFIG_BT_SIGNING=y
CONFIG_BT_PERIPHERAL=y
CONFIG_BT_DEVICE_NAME="Inventas Beacon"
CONFIG_BT_DEVICE_NAME_DYNAMIC=y
CONFIG_BT_FIXED_PASSKEY=y
#CONFIG_BT_BONDABLE=y

CONFIG_BT_KEYS_OVERWRITE_OLDEST=y
CONFIG_BT_SETTINGS=y
CONFIG_FLASH=y
CONFIG_FLASH_PAGE_LAYOUT=y
CONFIG_FLASH_MAP=y
CONFIG_NVS=y
CONFIG_SETTINGS=y



# LIS2DH12 accelerometer
CONFIG_LIS2DH=y
CONFIG_SENSOR=y
CONFIG_LIS2DH_ACCEL_RANGE_2G=y
CONFIG_LIS2DH_OPER_MODE_LOW_POWER=y
CONFIG_LIS2DH_ODR_1=y

# # LIS2HH12 accelerometer
# CONFIG_LIS2HH12=y
# CONFIG_SENSOR=y

CONFIG_CONSOLE_SUBSYS=y
#CONFIG_CONSOLE_GETCHAR=y
CONFIG_STDOUT_CONSOLE=y

CONFIG_CONSOLE=y
CONFIG_RTT_CONSOLE=y
CONFIG_USE_SEGGER_RTT=y
CONFIG_LOG=y
CONFIG_LOG_PRINTK=y
```

## src/main.c
```c
#include <zephyr.h>
#include <device.h>
#include <devicetree.h>
#include <drivers/gpio.h>


#include "bluetooth/gap_peripheral.h"



void main(void)
{
	init_bt_peripheral();
}
```
